## sdkconfig.defaults
```kconfig
CONFIG_COMPILER_OPTIMIZATION_SIZE=y
CONFIG_COMPILER_OPTIMIZATION_ASSERTIONS_SILENT=y
CONFIG_LOG_DEFAULT_LEVEL_NONE=y

CONFIG_VFS_SUPPORT_IO=n

CONFIG_ESP_WIFI_NVS_ENABLED=n
```
